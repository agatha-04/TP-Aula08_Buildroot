## br2-external/Config.in
```kconfig
menu "TP9 - Pacotes customizados"
source "$BR2_EXTERNAL_TP9_PATH/package/hcsr04-driver/Config.in"
endmenu
```

## br2-external/package/hcsr04-driver/Config.in
```kconfig
config BR2_PACKAGE_HCSR04_DRIVER
 bool "hcsr04-driver"
 depends on BR2_LINUX_KERNEL
 help
 Driver Linux do sensor ultrassonico HC-SR04
 utilizado no TP da Aula 9.
```
