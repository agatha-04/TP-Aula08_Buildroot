/dts-v1/;
/plugin/;
/ {
	compatible = "brcm,bcm2711";

	fragment@0 {
		target-path = "/";
		__overlay__ {
			hcsr04 {
				compatible = "unisanta,hcsr04";
				trig-gpios = <&gpio 23 0>;
				echo-gpios = <&gpio 24 0>;
				status = "okay";
			};
		};
	};
};

